# R7KA8D2AD register map
Vendor: Renesas Electronics Corporation; Series: RA8; File version: 1.10.02
Arm Cortex-M85 based Microcontroller RA8D2 group
CPU: CM85 r0p2, little endian, MPU, FPU, VTOR, 4 interrupt priority bits, 96 interrupts
Registers are 32-bit, read-write, reset 0x0 unless marked. A register's access mark holds for its fields unless they carry their own. Offsets are from the block's base; lines under a group give offsets from that group; [hi:lo] are bit positions; {n}, {i} and the like mark numbered series; 'fields as' and 'values as' point back to an identical list; <NAME> marks a mode.

## Memory map
0x02C1EDA0 TSD size 0x8 — Temperature Sensor Calibration Data
0x12C1EDA0 TSD_NS size 0x8 — Temperature Sensor Calibration Data
0x40000000 RMPU blocks up to offset 0x1038 — Renesas Memory Protection Unit
0x40002000 SRAM blocks up to offset 0x94 — SRAM Control
0x40003000 BUS blocks up to offset 0x1B0C — Bus Control
0x40006000 ICU_COMMON blocks up to offset 0xC0 — Interrupt Controller
0x40008000 CPSCU blocks up to offset 0x618 — CPU System Security Control Unit
{0x4000A000+0x40*n} DMAC{n:02} blocks up to offset 0x31 (n=0..7) — Direct memory access controller {n}
0x4000A800 DMA0 blocks up to offset 0x44 — DMAC Module Contorol
0x4000AC00 DTC0 blocks up to offset 0x24 — Data Transfer Controller
0x4000C000 ICU blocks up to offset 0x480 — Interrupt Controller
0x4000F000 CPU_CTRL blocks up to offset 0x848
0x40011000 CPU_OCD blocks up to offset 0x304 — OCD Function
0x4001B000 CPU_DBG blocks up to offset 0x204 — Debug Function
0x4001C000 CACHE blocks up to offset 0x208
0x4001C100 FCACHE blocks up to offset 0x42 — SYSTEM/FLASH
0x4001C800 TCM blocks up to offset 0x60
0x4001E000 SYSC blocks up to offset 0xD80 — System Control
0x40020000 IPC blocks up to offset 0x134 — Inter-Processor Communication
0x4011E000 FACI blocks up to offset 0x7E — Flash/CPU Interface
0x4013C000 MRAM blocks up to offset 0x3806 — MRAM System Register area
0x40201000 ELC blocks up to offset 0x11C — Event Link Controller
0x40202000 RTC blocks up to offset 0x8C — Realtime Clock
0x40202200 IWDT blocks up to offset 0x9 — Independent Watchdog Timer
0x40202400 CAC blocks up to offset 0xC — Clock Frequency Accuracy Measurement Circuit
0x40202600 WDT0 blocks up to offset 0x9 — Watchdog Timer
0x40202700 WDT1 blocks up to offset 0x9 — Watchdog Timer
0x40203000 MSTP size 0x14 — Module Stop Control
0x40204000 PSCU blocks up to offset 0x40 — Peripheral Security Control Unit
0x40212000 POEG blocks up to offset 0x304 — Port Output Enable Module for GPT
0x40220000 ULPT0 size 0x13
0x40220100 ULPT1 size 0x13
0x40221000 AGT0 blocks up to offset 0x10 — Low Power Asynchronous General Purpose Timer 0
0x40221100 AGT1 blocks up to offset 0x10 — Low Power Asynchronous General Purpose Timer 1
0x40233000 DAC0_B blocks up to offset 0x10 — 12-bit D/A converter
0x40233100 DAC1_B blocks up to offset 0x10 — 12-bit D/A converter
0x40235000 TSN size 0x1 — Temperature Sensor
0x40236000 ACMPHS0 blocks up to offset 0x45 — High-Speed Analog Comparator
0x40236100 ACMPHS1 blocks up to offset 0x45 — High-Speed Analog Comparator
0x40236200 ACMPHS2 blocks up to offset 0x45 — High-Speed Analog Comparator
0x40236300 ACMPHS3 blocks up to offset 0x45 — High-Speed Analog Comparator
0x40250000 USBFS blocks up to offset 0x408 — USB 2.0 Full-Speed Module
0x40252000 SDHI0 blocks up to offset 0x1E4 — SD Host Interface 0
0x40252400 SDHI1 blocks up to offset 0x1E4 — SD Host Interface 1
0x40256000 PDMIF blocks up to offset 0x4EC — Pulse Density Modulator Interface
0x4025D000 SSIE0 blocks up to offset 0x28 — Serial Sound Interface Enhanced (SSIE)
0x4025D100 SSIE1 blocks up to offset 0x28 — Serial Sound Interface Enhanced (SSIE)
0x4025E000 IIC0 size 0x1 — Inter-Integrated Circuit 0
0x4025E014 IIC0WU blocks up to offset 0x4 — Inter-Integrated Circuit 0 Wake-up Unit
0x4025E100 IIC1 size 0x1 — Inter-Integrated Circuit 1
0x4025E200 IIC2 size 0x1 — Inter-Integrated Circuit 2
0x40268000 OSPI0_B blocks up to offset 0x19C — Octa Serial Peripheral Interface
0x40268400 OSPI1_B blocks up to offset 0x19C — Octa Serial Peripheral Interface
0x40268800 DOTF0 size 0x8
0x40268900 DOTF1 size 0x8
0x40310000 CRC blocks up to offset 0xE — Cyclic Redundancy Check Calculator
0x40311000 DOC_B blocks up to offset 0x18 — Data Operation Circuit
{0x4030E000+0x100*n} GPT{n} blocks up to offset 0xF0 (n=320..329) — General PWM 32-bit Timer {n-320}
0x40322A00 GPT3210 blocks up to offset 0xF0 — General PWM 32-bit Timer 10
0x40322B00 GPT3211 blocks up to offset 0xF0 — General PWM 32-bit Timer 11
0x40322C00 GPT3212 blocks up to offset 0xF0 — General PWM 32-bit Timer 12
0x40322D00 GPT3213 blocks up to offset 0xF0 — General PWM 32-bit Timer 13
0x40323F00 GPT_OPS size 0x4 — Output Phase Switching Controller
0x40323F10 GPT_GTCLK size 0x4 — General PWM Timer Clock Controller
0x40324000 PDG blocks up to offset 0x3A — PWM Delay Generation Circuit
0x40338000 ADC_B blocks up to offset 0x2224 — 16-bit A/D Converter
0x40342000 GLCDC blocks up to offset 0x1454
0x40346000 MIPI_DSI blocks up to offset 0x88C
0x40346C00 MIPI_PHY0 blocks up to offset 0x4C — PHY Controller Top
0x40347000 MIPI_CSI0 blocks up to offset 0x298 — MIPI_CSI0 Register area
0x40347400 VIN0 blocks up to offset 0x310 — VIN0 Register area
0x40348000 CEU blocks up to offset 0x20A0 — Capture Engine Unit
0x40351000 USBHS blocks up to offset 0x16C — USB 2.0 High-Speed Module
{0x40358000+0x100*n} SCI{n}_B blocks up to offset 0x7C (n=0..9) — Serial Communication Interface
0x4035C000 SPI0_B blocks up to offset 0x70 — Serial Peripheral Interface n_B
0x4035C100 SPI1_B blocks up to offset 0x70 — Serial Peripheral Interface n_B
0x4035F000 I3C blocks up to offset 0x3E8 — I3C Bus Interface
0x4036F200 ECCMB0 blocks up to offset 0x14
0x4036F300 ECCMB1 blocks up to offset 0x14
0x40380000 CANFD0 blocks up to offset 0x1788
0x40382000 CANFD1 blocks up to offset 0x1788
0x403C0000 MFWD blocks up to offset 0x7C0C — Forwarding engine
0x403C8000 ESWM blocks up to offset 0x19424 — Layer 3 Ethernet Switch Module
0x403C9000 COMA blocks up to offset 0x45C — Common Agent
0x403CB000 RMAC0 blocks up to offset 0x530 — Ethernet MAC
0x403CD000 RMAC1 blocks up to offset 0x530 — Ethernet MAC
0x403CE000 GWCA0 blocks up to offset 0xC100 — Gateway CPU Agent
0x403E0000 GPTP blocks up to offset 0x10F0 — Generic PTP Timer
0x40400000 PORT0 size 0xC — Pmn Pin FunctionPort 0 Control RegistersPmn Pin Function Control Register
0x40400020 PORT1 size 0x10 — Pmn Pin FunctionPort 1 Control RegistersPmn Pin Function Control Register
0x40400040 PORT2 size 0x10 — Pmn Pin FunctionPort 2 Control RegistersPmn Pin Function Control Register
0x40400060 PORT3 size 0x10 — Pmn Pin FunctionPort 3 Control RegistersPmn Pin Function Control Register
0x40400080 PORT4 size 0x10 — Pmn Pin FunctionPort 4 Control RegistersPmn Pin Function Control Register
0x404000A0 PORT5 size 0xC — Pmn Pin FunctionPort 5 Control RegistersPmn Pin Function Control Register
0x404000C0 PORT6 size 0xC — Pmn Pin FunctionPort 6 Control RegistersPmn Pin Function Control Register
0x404000E0 PORT7 size 0xC — Pmn Pin FunctionPort 7 Control RegistersPmn Pin Function Control Register
0x40400100 PORT8 size 0xC — Pmn Pin FunctionPort 8 Control RegistersPmn Pin Function Control Register
0x40400120 PORT9 size 0xC — Pmn Pin FunctionPort 9 Control RegistersPmn Pin Function Control Register
0x40400140 PORTA size 0xC — Pmn Pin FunctionPort A Control RegistersPmn Pin Function Control Register
0x40400160 PORTB size 0xC — Pmn Pin FunctionPort B Control RegistersPmn Pin Function Control Register
0x40400180 PORTC size 0xC — Pmn Pin FunctionPort C Control RegistersPmn Pin Function Control Register
0x404001A0 PORTD size 0xC — Pmn Pin FunctionPort D Control RegistersPmn Pin Function Control Register
0x40400800 PFS blocks up to offset 0x560 — Control Register
0x40444000 DRW blocks up to offset 0x104 — 2D Drawing Engine
0x50000000 RMPU_NS blocks up to offset 0x1038 — Renesas Memory Protection Unit
0x50002000 SRAM_NS blocks up to offset 0x94 — SRAM Control
0x50003000 BUS_NS blocks up to offset 0x1B0C — Bus Control
0x50006000 ICU_COMMON_NS blocks up to offset 0xC0 — Interrupt Controller
0x50008000 CPSCU_NS blocks up to offset 0x618 — CPU System Security Control Unit
{0x5000A000+0x40*n} DMAC{n:02}_NS blocks up to offset 0x31 (n=0..7) — Direct memory access controller {n}
0x5000A800 DMA0_NS blocks up to offset 0x44 — DMAC Module Control
0x5000AC00 DTC0_NS blocks up to offset 0x24 — Data Transfer Controller for Non-secure
0x5000C000 ICU_NS blocks up to offset 0x480 — Interrupt Controller
0x5000F000 CPU_CTRL_NS blocks up to offset 0x848 — CPU(CTRL)
0x50011000 CPU_OCD_NS blocks up to offset 0x304 — OCD Function
0x5001B000 CPU_DBG_NS blocks up to offset 0x204 — Debug Function
0x5001C000 CACHE_NS blocks up to offset 0x208 — CACHE
0x5001C100 FCACHE_NS blocks up to offset 0x42 — SYSTEM/FLASH
0x5001C800 TCM_NS blocks up to offset 0x60
0x5001E000 SYSC_NS blocks up to offset 0xD80 — System Control
0x50020000 IPC_NS blocks up to offset 0x134
0x5013C000 MRAM_NS blocks up to offset 0x3806 — MS_NS System Register area
0x50201000 ELC_NS blocks up to offset 0x11C — Event Link Controller
0x50202000 RTC_NS blocks up to offset 0x8C — Realtime Clock
0x50202200 IWDT_NS blocks up to offset 0x9 — Independent Watchdog Timer
0x50202400 CAC_NS blocks up to offset 0xC — Clock Frequency Accuracy Measurement Circuit
0x50202600 WDT0_NS blocks up to offset 0x9 — Watchdog Timer
0x50202700 WDT1_NS blocks up to offset 0x9 — Watchdog Timer
0x50203000 MSTP_NS size 0x14 — Module Stop Control
0x50204000 PSCU_NS blocks up to offset 0x40 — Peripheral Security Control Unit
0x50212000 POEG_NS blocks up to offset 0x304 — Port Output Enable Module for GPT
0x50220000 ULPT0_NS size 0x13 — ULPT0
0x50220100 ULPT1_NS size 0x13 — ULPT1
0x50221000 AGT0_NS blocks up to offset 0x10 — Low Power Asynchronous General Purpose Timer 0
0x50221100 AGT1_NS blocks up to offset 0x10 — Low Power Asynchronous General Purpose Timer 1
0x50233000 DAC0_B_NS blocks up to offset 0x10 — 12-bit D/A converter
0x50233100 DAC1_B_NS blocks up to offset 0x10 — 12-bit D/A converter
0x50235000 TSN_NS size 0x1 — Temperature Sensor
0x50236000 ACMPHS0_NS blocks up to offset 0x45 — High-Speed Analog Comparator
0x50236100 ACMPHS1_NS blocks up to offset 0x45 — High-Speed Analog Comparator
0x50236200 ACMPHS2_NS blocks up to offset 0x45 — High-Speed Analog Comparator
0x50236300 ACMPHS3_NS blocks up to offset 0x45 — High-Speed Analog Comparator
0x50250000 USBFS_NS blocks up to offset 0x408 — USB 2.0 Full-Speed Module
0x50252000 SDHI0_NS blocks up to offset 0x1E4 — SD Host Interface 0
0x50252400 SDHI1_NS blocks up to offset 0x1E4 — SD Host Interface 1
0x50256000 PDMIF_NS blocks up to offset 0x4EC — PDMIF_NS Register area
0x5025D000 SSIE0_NS blocks up to offset 0x28 — Serial Sound Interface Enhanced (SSIE)
0x5025D100 SSIE1_NS blocks up to offset 0x28 — Serial Sound Interface Enhanced (SSIE)
0x5025E000 IIC0_NS size 0x14 — Inter-Integrated Circuit 0
0x5025E014 IIC0WU_NS blocks up to offset 0x4 — Inter-Integrated Circuit 0 Wake-up Unit
0x5025E100 IIC1_NS size 0x14 — Inter-Integrated Circuit 1
0x5025E200 IIC2_NS size 0x14 — Inter-Integrated Circuit 2
0x50268000 OSPI0_B_NS blocks up to offset 0x19C — Octa Serial Peripheral Interface
0x50268400 OSPI1_B_NS blocks up to offset 0x19C — Octa Serial Peripheral Interface
0x50268800 DOTF0_NS size 0x8
0x50268900 DOTF1_NS size 0x8
0x50310000 CRC_NS blocks up to offset 0xE — Cyclic Redundancy Check Calculator
0x50311000 DOC_B_NS blocks up to offset 0x18 — Data Operation Circuit
{0x5030E000+0x100*n} GPT{n}_NS blocks up to offset 0xF0 (n=320..329) — General PWM 32-bit Timer {n-320}
0x50322A00 GPT3210_NS blocks up to offset 0xF0 — General PWM 32-bit Timer 10
0x50322B00 GPT3211_NS blocks up to offset 0xF0 — General PWM 32-bit Timer 11
0x50322C00 GPT3212_NS blocks up to offset 0xF0 — General PWM 32-bit Timer 12
0x50322D00 GPT3213_NS blocks up to offset 0xF0 — General PWM 32-bit Timer 13
0x50323F00 GPT_OPS_NS size 0x4 — Output Phase Switching Controller
0x50323F10 GPT_GTCLK_NS size 0x4 — General PWM Timer Clock Controller
0x50324000 PDG_NS blocks up to offset 0x3A — PWM Delay Generation Circuit
0x50338000 ADC_B_NS blocks up to offset 0x2224 — 16-bit A/D Converter NS
0x50342000 GLCDC_NS blocks up to offset 0x1454
0x50346000 MIPI_DSI_NS blocks up to offset 0x88C — MIPI_DSI
0x50346C00 MIPI_PHY0_NS blocks up to offset 0x4C — PHY Controller Top
0x50347000 MIPI_CSI0_NS blocks up to offset 0x298 — MIPI_CSI0_NS Register area
0x50347400 VIN0_NS blocks up to offset 0x310 — VIN0_NS Register area
0x50348000 CEU_NS blocks up to offset 0x20A0 — Capture Engine Unit
0x50351000 USBHS_NS blocks up to offset 0x16C — USB 2.0 High-Speed Module
{0x50358000+0x100*n} SCI{n}_B_NS blocks up to offset 0x7C (n=0..9) — Serial Communication Interface
0x5035C000 SPI0_B_NS blocks up to offset 0x70 — Serial Peripheral Interface n_B_NS
0x5035C100 SPI1_B_NS blocks up to offset 0x70 — Serial Peripheral Interface n_B_NS
0x5035F000 I3C_NS blocks up to offset 0x3E8 — I3C Bus Interface
0x5036F200 ECCMB0_NS blocks up to offset 0x14 — ECCMB0
0x5036F300 ECCMB1_NS blocks up to offset 0x14 — ECCMB1
0x50380000 CANFD0_NS blocks up to offset 0x1788 — CANFD0
0x50382000 CANFD1_NS blocks up to offset 0x1788 — CANFD1
0x503C0000 MFWD_NS blocks up to offset 0x7C0C — Forwarding engine
0x503C8000 ESWM_NS blocks up to offset 0x19424 — Layer 3 Ethernet Switch Module
0x503C9000 COMA_NS blocks up to offset 0x45C — COMA_NS Module Activation1
0x503CA000 ETHA0_NS blocks up to offset 0x52C — Ethernet Agent
0x503CB000 RMAC0_NS blocks up to offset 0x530 — Ethernet MAC
0x503CC000 ETHA1_NS blocks up to offset 0x52C — Ethernet Agent
0x503CD000 RMAC1_NS blocks up to offset 0x530 — Ethernet MAC
0x503CE000 GWCA0_NS blocks up to offset 0xC100 — Gateway CPU Agent
0x503E0000 GPTP_NS blocks up to offset 0x10F0 — Generic PTP Timer
0x50400000 PORT0_NS size 0xC — Pmn Pin FunctionPort 0 Control RegistersPmn Pin Function Control Register
0x50400020 PORT1_NS size 0x10 — Pmn Pin FunctionPort 1 Control RegistersPmn Pin Function Control Register
0x50400040 PORT2_NS size 0x10 — Pmn Pin FunctionPort 2 Control RegistersPmn Pin Function Control Register
0x50400060 PORT3_NS size 0x10 — Pmn Pin FunctionPort 3 Control RegistersPmn Pin Function Control Register
0x50400080 PORT4_NS size 0x10 — Pmn Pin FunctionPort 4 Control RegistersPmn Pin Function Control Register
0x504000A0 PORT5_NS size 0xC — Pmn Pin FunctionPort 5 Control RegistersPmn Pin Function Control Register
0x504000C0 PORT6_NS size 0xC — Pmn Pin FunctionPort 6 Control RegistersPmn Pin Function Control Register
0x504000E0 PORT7_NS size 0xC — Pmn Pin FunctionPort 7 Control RegistersPmn Pin Function Control Register
0x50400100 PORT8_NS size 0xC — Pmn Pin FunctionPort 8 Control RegistersPmn Pin Function Control Register
0x50400120 PORT9_NS size 0xC — Pmn Pin FunctionPort 9 Control RegistersPmn Pin Function Control Register
0x50400140 PORTA_NS size 0xC — Pmn Pin FunctionPort A Control RegistersPmn Pin Function Control Register
0x50400160 PORTB_NS size 0xC — Pmn Pin FunctionPort B Control RegistersPmn Pin Function Control Register
0x50400180 PORTC_NS size 0xC — Pmn Pin FunctionPort C Control RegistersPmn Pin Function Control Register
0x504001A0 PORTD_NS size 0xC — Pmn Pin FunctionPort D Control RegistersPmn Pin Function Control Register
0x50400800 PFS_NS blocks up to offset 0x560 — Control Register
0x50444000 DRW_NS blocks up to offset 0x104 — 2D Drawing Engine

## Interrupts
{n} IEL{n} (ICU) (n=0..95) — ICU Interrupt {n}

## Licence text in the file
This software is supplied by Renesas Electronics Corporation and is only intended for use with Renesas products. No other uses are authorized. This software is owned by. Renesas Electronics Corporation and is protected under all applicable laws, including copyright laws. . THIS SOFTWARE IS PROVIDED "AS IS" AND RENESAS MAKES NO WARRANTIES REGARDING. THIS SOFTWARE, WHETHER EXPRESS, IMPLIED OR STATUTORY, INCLUDING BUT NOT LIMITED TO. WARRANTIES OF MERCHANTABILITY, FITNESS FOR A PARTICULAR PURPOSE AND NON-INFRINGEMENT. ALL SUCH WARRANTIES ARE EXPRESSLY DISCLAIMED. TO THE MAXIMUM EXTENT PERMITTED NOT. PROHIBITED BY LAW, NEITHER RENESAS ELECTRONICS CORPORATION NOR ANY OF ITS AFFILIATED. COMPANIES SHALL BE LIABLE FOR ANY DIRECT, INDIRECT, SPECIAL, INCIDENTAL OR CONSEQUENTIAL. DAMAGES FOR ANY REASON RELATED TO THIS SOFTWARE, EVEN IF RENESAS OR ITS AFFILIATES HAVE. BEEN ADVISED OF THE POSSIBILITY OF SUCH DAMAGES. . Renesas reserves the right, without notice, to make changes to this software and to discontinue the availability of this software. By using this software, you agree to the additional terms and conditions found by accessing the following link: http://www.renesas.com/disclaimer
