# RZN2H register map
Vendor: Renesas Electronics Corporation; Series: RZN; File version: 1.00.00
Arm Cortex-R52 based device
CPU: other r0p0, little endian, MPU, no FPU, VTOR, 4 interrupt priority bits, 624 interrupts
Registers are 32-bit, read-write, reset 0x0 unless marked. A register's access mark holds for its fields unless they carry their own. Offsets are from the block's base; lines under a group give offsets from that group; [hi:lo] are bit positions; {n}, {i} and the like mark numbered series; 'fields as' and 'values as' point back to an identical list; <NAME> marks a mode.

## Memory map
0x80000000 GPT09_0 blocks up to offset 0xE0 — General PWM Timer 09
0x80000100 GPT09_1 blocks up to offset 0xE0 — General PWM Timer 09
0x80000200 GPT09_2 blocks up to offset 0xE0 — General PWM Timer 09
0x80000300 GPT09_3 blocks up to offset 0xE0 — General PWM Timer 09
0x80000400 GPT09_4 blocks up to offset 0xE0 — General PWM Timer 09
0x80000500 GPT09_5 blocks up to offset 0xE0 — General PWM Timer 09
0x80000600 GPT09_6 blocks up to offset 0xE0 — General PWM Timer 09
0x80004000 CRC0 blocks up to offset 0xC — CRC Unit 0
0x80005000 SCI0 blocks up to offset 0x78 — Serial Communication Interface 0
0x80005400 SCI1 blocks up to offset 0x78 — Serial Communication Interface 1
0x80005800 SCI2 blocks up to offset 0x78 — Serial Communication Interface 2
0x80005C00 SCI3 blocks up to offset 0x78 — Serial Communication Interface 3
0x80006000 SCI4 blocks up to offset 0x78 — Serial Communication Interface 4
0x80007000 SPI0 blocks up to offset 0x6D — Serial Peripheral Interface 0
0x80007400 SPI1 blocks up to offset 0x6D — Serial Peripheral Interface 1
0x80007800 SPI2 blocks up to offset 0x6D — Serial Peripheral Interface 2
0x80008000 ADC122 blocks up to offset 0x1F2 — 12-Bit A/D converter 2
0x80040000 CANFD blocks up to offset 0x14048
0x80080000 CMTC blocks up to offset 0x802 — Compare Match Timer Control
0x80080002 CMT0 size 0x6 — Compare Match Timer 0
0x80080008 CMT1 size 0x6 — Compare Match Timer 1
0x80080402 CMT2 size 0x6 — Compare Match Timer 2
0x80080408 CMT3 size 0x6 — Compare Match Timer 3
0x80080802 CMT4 size 0x6 — Compare Match Timer 4
0x80080808 CMT5 size 0x6 — Compare Match Timer 5
0x80081000 CMTW0 blocks up to offset 0x28 — Compare Match Timer W
0x80081400 CMTW1 blocks up to offset 0x28 — Compare Match Timer W
0x80082000 WDT0 blocks up to offset 0x7 — Watchdog Timer 0
0x80082400 WDT1 blocks up to offset 0x7 — Watchdog Timer 1
0x80082800 WDT2 blocks up to offset 0x7 — Watchdog Timer 2
0x80082C00 WDT3 blocks up to offset 0x7 — Watchdog Timer 3
0x80083000 WDT4 blocks up to offset 0x7 — Watchdog Timer 4
0x80083400 WDT5 blocks up to offset 0x7 — Watchdog Timer 5
0x80084000 DOC blocks up to offset 0x6 — Data Operation Circuit
0x80086000 TSU_B0 blocks up to offset 0x3C — Temperature Sensor Unit
0x80087000 POEG1 blocks up to offset 0xC04 — GPT Port Output Enable 1
0x80088000 IIC0 size 0x14 — I2C Bus Interface 0
0x80088400 IIC1 size 0x14 — I2C Bus Interface 1
0x800C0000 DMAC0 blocks up to offset 0x724 — DMA Controller 0
0x800C1000 DMAC1 blocks up to offset 0x724 — DMA Controller 1
0x800C2000 DMAC2 blocks up to offset 0x724 — DMA Controller 2
0x80100000 GMAC0 blocks up to offset 0x1564
0x80110000 ETHSS blocks up to offset 0x30C — Ethernet Subsystem
0x80110200 ESC_INI size 0x14 — Initial Configuration 1 for EtherCAT Slave Controller
0x80110400 ETHSW_PTP blocks up to offset 0x820 — Ethernet Switch for PTP
0x80110400 GMACC size 0x4
0x80120000 ETHSW blocks up to offset 0x3FDC — Ethernet Switch
0x80130000 ESC blocks up to offset 0xE0C — EtherCAT Slave Controller
0x801C0000 XSPI0 blocks up to offset 0x19C — xSPI
0x801C1000 XSPI1 blocks up to offset 0x19C — xSPI
0x80210000 BSC blocks up to offset 0x88 — Bus State Controller
0x80240000 MBXSEM blocks up to offset 0xD98 — Mailbox and Semaphore
0x80241000 SHOSTIF blocks up to offset 0x4C
0x80280000 SYSC_NS blocks up to offset 0x334 — System Control for Non-safety region
0x80290000 ELO size 0x8 — Event Link Option Setting
0x80290008 GPT_IC size 0x4 — Input Capture Selection
0x80291000 ENCSS size 0x168 — Encoder Interface Subsystem
0x80292000 PCIE_SPL0 size 0x28 — PCIe Supplemental Settings Channel 0
0x80292030 PCIE_SPL1 size 0x28 — PCIe Supplemental Settings Channel 1
0x80292060 PCIE_LNK size 0x4 — PCIe Supplimental Settings for LINK MODE
0x80293000 XSPI0_MISC size 0x10 — xSPI0 Voltage and Size Registers
0x80293100 XSPI1_MISC size 0x10 — xSPI1 Voltage and Size Registers
0x80294100 MD_NS size 0x4 — Operating Mode for Non-safety Area
0x80294200 RWP_NS size 0x4 — Register Write Protection for Non-safety Area
0x802A0000 ICU_NS blocks up to offset 0xB98 — Interrupt Controller in Non Safety Domain
0x802A0698 ELC size 0x104 — Event Link Controller
0x802A07D0 DMA size 0x48 — DMAC Configuration
0x802B0000 PORT_SRN blocks up to offset 0x1F05 — I/O Ports (Safety region N)
0x802C0000 PORT_NSR blocks up to offset 0x1F04 — I/O Ports (Non safety region)
0x80300000 DDRSS blocks up to offset 0x201C
0x81000000 GPT10_0 blocks up to offset 0xE0 — General PWM Timer 10
0x81000100 GPT10_1 blocks up to offset 0xE0 — General PWM Timer 10
0x81000200 GPT10_2 blocks up to offset 0xE0 — General PWM Timer 10
0x81000300 GPT10_3 blocks up to offset 0xE0 — General PWM Timer 10
0x81004000 CRC1 blocks up to offset 0xC — CRC Unit 1
0x81005000 SCI5 blocks up to offset 0x78 — Serial Communication Interface 5
0x81007000 SPI3 blocks up to offset 0x6D — Serial Peripheral Interface 3
0x81008000 IIC2 size 0x14 — I2C Bus Interface 2
0x81009000 RTC blocks up to offset 0x70 — Real Time Clock
0x8100A000 POEG2 blocks up to offset 0xC04 — GPT Port Output Enable 2
0x81040000 SYSRAM0 size 0x10C — System SRAM 0
0x81041000 SYSRAM1 size 0x10C — System SRAM 1
0x81042000 SYSRAM2 size 0x10C — System SRAM 2
0x81043000 SYSRAM3 size 0x10C — System SRAM 3
0x810C0000 OTP size 0x1C — One-Time Programmable Memory
0x81240000 MPU_AC size 0x4 — Master MPU Access Control
0x81280000 SYSC_S blocks up to offset 0x338 — Register Write Protection for Safety Area
0x81288000 CLMA0 blocks up to offset 0x15 — Clock Monitor Circuit 0
0x81288020 CLMA1 blocks up to offset 0x15 — Clock Monitor Circuit 1
0x81288040 CLMA2 blocks up to offset 0x15 — Clock Monitor Circuit 2
0x81288060 CLMA3 blocks up to offset 0x15 — Clock Monitor Circuit 3
0x81288080 CLMA4 blocks up to offset 0x15 — Clock Monitor Circuit 4
0x812880A0 CLMA5 blocks up to offset 0x15 — Clock Monitor Circuit 5
0x812880C0 CLMA6 blocks up to offset 0x15 — Clock Monitor Circuit 6
0x81290100 ADXC0 size 0x18 — Address Expander Control 0
0x81290200 SSC blocks up to offset 0x1008 — Slave Stop Control
0x81290300 MSAC blocks up to offset 0x1028 — Master and Slave Access Control
0x81290400 MPU10 size 0x88 — Master MPU 10
0x81290500 MPU11 size 0x88 — Master MPU 11
0x81290600 MPU12 size 0x88 — Master MPU 12
0x81290700 MPU13 size 0x88 — Master MPU 13
0x81290800 MPU14 size 0x84 — Master MPU 14
0x81290900 MPU15 size 0x90 — Master MPU 15
0x81291100 ADXC1 size 0x1C — Address Expander Control 1
0x81291400 MPU0 size 0x88 — Master MPU 0
0x81291500 MPU1 size 0x88 — Master MPU 1
0x81291600 MPU2 size 0x84 — Master MPU 2
0x81291700 MPU3 size 0x84 — Master MPU 3
0x81291800 MPU4 size 0x88 — Master MPU 4
0x81291900 MPU5 size 0x88 — Master MPU 5
0x81291A00 MPU6 size 0x88 — Master MPU 6
0x81291B00 MPU7 size 0x90 — Master MPU 7
0x81291C00 MPU8 size 0x90 — Master MPU 8
0x81291D00 MPU9 size 0x90 — Master MPU 9
0x81293000 SYSRAM_CTL size 0x40 — System SRAM Control
0x81294000 SHOSTIF_CFG size 0x4
0x81295000 TCMAW blocks up to offset 0x14 — TCM access wait state
0x81295020 CA55 size 0x24 — Cortex-A55
0x81295100 WDT_DBG size 0x18 — WDT for Debug
0x81296000 RWP_S size 0x4 — Register Write Protection for Safety Area
0x812A0000 ICU_S blocks up to offset 0x48 — Interrupt Controller in Safety Domain
0x812C0000 PORT_SRS blocks up to offset 0x1F05 — I/O Ports (Safety region S)
0x8C200000 GSC blocks up to offset 0x24 — Global System Counter
0x90001000 MTU blocks up to offset 0xA85 — Multi-Function Timer Pulse Unit
0x90001100 MTU3 blocks up to offset 0x174 — Multi-Function Timer Pulse Unit Channel 3
0x90001200 MTU4 blocks up to offset 0x78 — Multi-Function Timer Pulse Unit Channel 4
0x90001290 MTU_NF blocks up to offset 0x806 — Multi-Function Timer Pulse Unit Noise Filter
0x90001300 MTU0 blocks up to offset 0x29 — Multi-Function Timer Pulse Unit Channel 0
0x90001380 MTU1 blocks up to offset 0x2C — Multi-Function Timer Pulse Unit Channel 1
0x90001400 MTU2 blocks up to offset 0xD — Multi-Function Timer Pulse Unit Channel 2
0x90001600 MTU8 blocks up to offset 0x1C — Multi-Function Timer Pulse Unit Channel 8
0x90001900 MTU6 blocks up to offset 0x174 — Multi-Function Timer Pulse Unit Channel 6
0x90001A00 MTU7 blocks up to offset 0x78 — Multi-Function Timer Pulse Unit Channel 7
0x90001C00 MTU5 blocks up to offset 0xB7 — Multi-Function Timer Pulse Unit Channel 5
0x90002000 GPT00_0 blocks up to offset 0xE0 — General PWM Timer 00
0x90002100 GPT00_1 blocks up to offset 0xE0 — General PWM Timer 00
0x90002200 GPT00_2 blocks up to offset 0xE0 — General PWM Timer 00
0x90002300 GPT00_3 blocks up to offset 0xE0 — General PWM Timer 00
0x90002400 GPT00_4 blocks up to offset 0xE0 — General PWM Timer 00
0x90003000 GPT01_0 blocks up to offset 0xE0 — General PWM Timer 01
0x90003100 GPT01_1 blocks up to offset 0xE0 — General PWM Timer 01
0x90003200 GPT01_2 blocks up to offset 0xE0 — General PWM Timer 01
0x90003300 GPT01_3 blocks up to offset 0xE0 — General PWM Timer 01
0x90003400 GPT01_4 blocks up to offset 0xE0 — General PWM Timer 01
0x90004000 GPT02_0 blocks up to offset 0xE0 — General PWM Timer 02
0x90004100 GPT02_1 blocks up to offset 0xE0 — General PWM Timer 02
0x90004200 GPT02_2 blocks up to offset 0xE0 — General PWM Timer 02
0x90004300 GPT02_3 blocks up to offset 0xE0 — General PWM Timer 02
0x90004400 GPT02_4 blocks up to offset 0xE0 — General PWM Timer 02
0x90005000 GPT03_0 blocks up to offset 0xE0 — General PWM Timer 03
0x90005100 GPT03_1 blocks up to offset 0xE0 — General PWM Timer 03
0x90005200 GPT03_2 blocks up to offset 0xE0 — General PWM Timer 03
0x90005300 GPT03_3 blocks up to offset 0xE0 — General PWM Timer 03
0x90005400 GPT03_4 blocks up to offset 0xE0 — General PWM Timer 03
0x90006000 GPT04_0 blocks up to offset 0xE0 — General PWM Timer 04
0x90006100 GPT04_1 blocks up to offset 0xE0 — General PWM Timer 04
0x90006200 GPT04_2 blocks up to offset 0xE0 — General PWM Timer 04
0x90006300 GPT04_3 blocks up to offset 0xE0 — General PWM Timer 04
0x90006400 GPT04_4 blocks up to offset 0xE0 — General PWM Timer 04
0x90007000 GPT05_0 blocks up to offset 0xE0 — General PWM Timer 05
0x90007100 GPT05_1 blocks up to offset 0xE0 — General PWM Timer 05
0x90007200 GPT05_2 blocks up to offset 0xE0 — General PWM Timer 05
0x90007300 GPT05_3 blocks up to offset 0xE0 — General PWM Timer 05
0x90007400 GPT05_4 blocks up to offset 0xE0 — General PWM Timer 05
0x90010000 TFU0 blocks up to offset 0x38 — Trigonometric Function Unit 0
0x90014000 ADC120 blocks up to offset 0x1F2 — 12-Bit A/D converter 0
0x90014400 ADC121 blocks up to offset 0x1F2 — 12-Bit A/D converter 1
0x90018000 POE3 blocks up to offset 0x42 — Port Output Enable 3
0x90019000 POEG0 blocks up to offset 0xC0C — GPT Port Output Enable 0
0x90020000 DSMIF0 blocks up to offset 0x7F0 — Delta-sigma Interface 0
0x90021000 DSMIF1 blocks up to offset 0x7F0 — Delta-sigma Interface 1
0x90022000 DSMIF2 blocks up to offset 0x7F0 — Delta-sigma Interface 2
0x90023000 DSMIF3 blocks up to offset 0x7F0 — Delta-sigma Interface 3
0x90024000 DSMIF4 blocks up to offset 0x7F0 — Delta-sigma Interface 4
0x90025000 DSMIF5 blocks up to offset 0x7F0 — Delta-sigma Interface 5
{0x90030000+0x400*n} SCIE{n} blocks up to offset 0x78 (n=0..7) — Serial Communication Interface E {n}
0x90100000 GPT06_0 blocks up to offset 0xE0 — General PWM Timer 06
0x90100100 GPT06_1 blocks up to offset 0xE0 — General PWM Timer 06
0x90100200 GPT06_2 blocks up to offset 0xE0 — General PWM Timer 06
0x90100300 GPT06_3 blocks up to offset 0xE0 — General PWM Timer 06
0x90100400 GPT06_4 blocks up to offset 0xE0 — General PWM Timer 06
0x90101000 GPT07_0 blocks up to offset 0xE0 — General PWM Timer 07
0x90101100 GPT07_1 blocks up to offset 0xE0 — General PWM Timer 07
0x90101200 GPT07_2 blocks up to offset 0xE0 — General PWM Timer 07
0x90101300 GPT07_3 blocks up to offset 0xE0 — General PWM Timer 07
0x90101400 GPT07_4 blocks up to offset 0xE0 — General PWM Timer 07
0x90102000 GPT08_0 blocks up to offset 0xE0 — General PWM Timer 08
0x90102100 GPT08_1 blocks up to offset 0xE0 — General PWM Timer 08
0x90102200 GPT08_2 blocks up to offset 0xE0 — General PWM Timer 08
0x90102300 GPT08_3 blocks up to offset 0xE0 — General PWM Timer 08
0x90102400 GPT08_4 blocks up to offset 0xE0 — General PWM Timer 08
0x90110000 TFU1 blocks up to offset 0x38 — Trigonometric Function Unit 1
0x90120000 DSMIF6 blocks up to offset 0x7F0 — Delta-sigma Interface 6
0x90121000 DSMIF7 blocks up to offset 0x7F0 — Delta-sigma Interface 7
0x90122000 DSMIF8 blocks up to offset 0x7F0 — Delta-sigma Interface 8
0x90123000 DSMIF9 blocks up to offset 0x7F0 — Delta-sigma Interface 9
0x90130000 SCIE8 blocks up to offset 0x78 — Serial Communication Interface E 8
0x90130400 SCIE9 blocks up to offset 0x78 — Serial Communication Interface E 9
0x90130800 SCIE10 blocks up to offset 0x78 — Serial Communication Interface E 10
0x90130C00 SCIE11 blocks up to offset 0x78 — Serial Communication Interface E 11
{0x90200000+0x10000*n} HDSLD{n} blocks up to offset 0x68 (n=0..11) — HIPERFACE DSL for Drive Interface Unit {n}
{0x90161000+0x10000*n} HDSLS{n} blocks up to offset 0x80 (n=10..19) — HIPERFACE DSL for Safe Channel 1 Unit {n-10}
{0x900C2000+0x10000*n} HDSLS{n} blocks up to offset 0x40 (n=20..29) — HIPERFACE DSL for Safe Channel 2 Unit {n-20}
{0x90203000+0x10000*n} BISS{n} blocks up to offset 0xFC (n=0..11) — BiSS-C Unit {n}
{0x90204000+0x10000*n} ENDAT{n} blocks up to offset 0x40 (n=0..11) — EnDat2.2 Unit {n}
{0x90206000+0x10000*n} AFMT{n} blocks up to offset 0x204 (n=0..11) — A-format Unit {n}
0x902A1000 HDSLS110 blocks up to offset 0x80 — HIPERFACE DSL for Safe Channel 1 Unit 10
0x902A2000 HDSLS210 blocks up to offset 0x40 — HIPERFACE DSL for Safe Channel 2 Unit 10
0x902B1000 HDSLS111 blocks up to offset 0x80 — HIPERFACE DSL for Safe Channel 1 Unit 11
0x902B2000 HDSLS211 blocks up to offset 0x40 — HIPERFACE DSL for Safe Channel 2 Unit 11
0x902C0000 ENCOUT blocks up to offset 0x18 — Encoder Divided-Output Module
0x90300000 HDSLD12 blocks up to offset 0x68 — HIPERFACE DSL for Drive Interface Unit 12
0x90301000 HDSLS112 blocks up to offset 0x80 — HIPERFACE DSL for Safe Channel 1 Unit 12
0x90302000 HDSLS212 blocks up to offset 0x40 — HIPERFACE DSL for Safe Channel 2 Unit 12
0x90303000 BISS12 blocks up to offset 0xFC — BiSS-C Unit 12
0x90304000 ENDAT12 blocks up to offset 0x40 — EnDat2.2 Unit 12
0x90306000 AFMT12 blocks up to offset 0x204 — A-format Unit 12
0x90310000 HDSLD13 blocks up to offset 0x68 — HIPERFACE DSL for Drive Interface Unit 13
0x90311000 HDSLS113 blocks up to offset 0x80 — HIPERFACE DSL for Safe Channel 1 Unit 13
0x90312000 HDSLS213 blocks up to offset 0x40 — HIPERFACE DSL for Safe Channel 2 Unit 13
0x90313000 BISS13 blocks up to offset 0xFC — BiSS-C Unit 13
0x90314000 ENDAT13 blocks up to offset 0x40 — EnDat2.2 Unit 13
0x90316000 AFMT13 blocks up to offset 0x204 — A-format Unit 13
0x90320000 HDSLD14 blocks up to offset 0x68 — HIPERFACE DSL for Drive Interface Unit 14
0x90321000 HDSLS114 blocks up to offset 0x80 — HIPERFACE DSL for Safe Channel 1 Unit 14
0x90322000 HDSLS214 blocks up to offset 0x40 — HIPERFACE DSL for Safe Channel 2 Unit 14
0x90323000 BISS14 blocks up to offset 0xFC — BiSS-C Unit 14
0x90324000 ENDAT14 blocks up to offset 0x40 — EnDat2.2 Unit 14
0x90326000 AFMT14 blocks up to offset 0x204 — A-format Unit 14
0x90330000 HDSLD15 blocks up to offset 0x68 — HIPERFACE DSL for Drive Interface Unit 15
0x90331000 HDSLS115 blocks up to offset 0x80 — HIPERFACE DSL for Safe Channel 1 Unit 15
0x90332000 HDSLS215 blocks up to offset 0x40 — HIPERFACE DSL for Safe Channel 2 Unit 15
0x90333000 BISS15 blocks up to offset 0xFC — BiSS-C Unit 15
0x90334000 ENDAT15 blocks up to offset 0x40 — EnDat2.2 Unit 15
0x90336000 AFMT15 blocks up to offset 0x204 — A-format Unit 15
0x92000000 GMAC1 blocks up to offset 0x1564
0x92010000 GMAC2 blocks up to offset 0x1564
0x92040000 USBHC blocks up to offset 0x834 — USB 2.0 HS Host Module
0x92041000 USBF blocks up to offset 0x724 — USB 2.0 Host and Function Module
0x92080000 SDHI0 blocks up to offset 0x103C — SD/MMC Host Interface
0x92090000 SDHI1 blocks up to offset 0x103C — SD/MMC Host Interface
0x920C0000 LCDC blocks up to offset 0x23B40 — LCD Controller
0x92100000 PCIE0 blocks up to offset 0x8158 — PCI Express 3.0 Interface 0
0x92102000 PCIE_PHY blocks up to offset 0x5C0
0x92110000 PCIE1 blocks up to offset 0x8158 — PCI Express 3.0 Interface 1

## Licence text in the file
Copyright (c) 2020 - 2025 Renesas Electronics Corporation and/or its affiliates * * SPDX-License-Identifier: BSD-3-Clause
