# RZT2L register map
Vendor: Renesas Electronics Corporation; Series: RZT; File version: 1.20.00
Arm Cortex-R52 based device
CPU: other r0p0, little endian, MPU, no FPU, VTOR, 4 interrupt priority bits, 624 interrupts
Registers are 32-bit, read-write, reset 0x0 unless marked. A register's access mark holds for its fields unless they carry their own. Offsets are from the block's base; lines under a group give offsets from that group; [hi:lo] are bit positions; {n}, {i} and the like mark numbered series; 'fields as' and 'values as' point back to an identical list; <NAME> marks a mode.

## Memory map
0x80000000 GPT7 blocks up to offset 0xE0 — General PWM Timer 7
0x80000100 GPT8 blocks up to offset 0xE0 — General PWM Timer 8
0x80000200 GPT9 blocks up to offset 0xE0 — General PWM Timer 9
0x80000300 GPT10 blocks up to offset 0xE0 — General PWM Timer 10
0x80000400 GPT11 blocks up to offset 0xE0 — General PWM Timer 11
0x80000500 GPT12 blocks up to offset 0xE0 — General PWM Timer 12
0x80000600 GPT13 blocks up to offset 0xE0 — General PWM Timer 13
0x80001000 SCI0 blocks up to offset 0x74 — Serial Communication Interface 0
0x80001400 SCI1 blocks up to offset 0x74 — Serial Communication Interface 1
0x80001800 SCI2 blocks up to offset 0x74 — Serial Communication Interface 2
0x80001C00 SCI3 blocks up to offset 0x74 — Serial Communication Interface 3
0x80002000 SCI4 blocks up to offset 0x74 — Serial Communication Interface 4
0x80003000 SPI0 blocks up to offset 0x6D — Serial Peripheral Interface 0
0x80003400 SPI1 blocks up to offset 0x6D — Serial Peripheral Interface 1
0x80003800 SPI2 blocks up to offset 0x6D — Serial Peripheral Interface 2
0x80004000 CRC0 blocks up to offset 0xC — CRC Unit 0
0x80020000 CANFD blocks up to offset 0x14048
0x80040000 CMTC blocks up to offset 0x802 — Compare Match Timer Control
0x80040002 CMT0 size 0x6 — Compare Match Timer 0
0x80040008 CMT1 size 0x6 — Compare Match Timer 1
0x80040402 CMT2 size 0x6 — Compare Match Timer 2
0x80040408 CMT3 size 0x6 — Compare Match Timer 3
0x80040802 CMT4 size 0x6 — Compare Match Timer 4
0x80040808 CMT5 size 0x6 — Compare Match Timer 5
0x80041000 CMTW0 blocks up to offset 0x28 — Compare Match Timer W
0x80041400 CMTW1 blocks up to offset 0x28 — Compare Match Timer W
0x80042000 WDT0 blocks up to offset 0x7 — Watchdog Timer 0
0x80043000 IIC0 size 0x14 — I2C Bus Interface 0
0x80043400 IIC1 size 0x14 — I2C Bus Interface 1
0x80044000 DOC blocks up to offset 0x6 — Data Operation Circuit
0x80046000 TSU size 0x14 — Temperature Sensor Unit
0x80047000 POEG1 blocks up to offset 0xC04 — GPT Port Output Enable 1
0x80080000 DMAC0 blocks up to offset 0x724 — DMA Controller 0
0x80081000 DMAC1 blocks up to offset 0x724 — DMA Controller 1
0x80090000 ICU_NS size 0x10 — Interrupt Controller in Non Safety Domain
0x80090010 ELC size 0x4C — Evnet Link Controller
0x80090060 DMA blocks up to offset 0x3C — DMAC Configuration
0x800A0000 PORT_NSR blocks up to offset 0xE12 — I/O Ports (Non safety region)
0x80100000 GMAC blocks up to offset 0x105C — Ethernet MAC
0x80110000 ETHSS blocks up to offset 0x118 — Ethernet Subsystem
0x80110200 ESC_INI size 0x10 — Initial Configuration 1 for EtherCAT Slave Controller
0x80110400 GMAC_PTP blocks up to offset 0x820 — GMAC for PTP
0x80130000 ESC blocks up to offset 0xE0C — EtherCAT Slave Controller
0x80200000 USBHC blocks up to offset 0x814 — USB 2.0 HS Host Module
0x80201000 USBF blocks up to offset 0x724 — USB 2.0 Host and Function Module
0x80210000 BSC blocks up to offset 0x88 — Bus State Controller
0x80220000 XSPI0 blocks up to offset 0x19C — xSPI
0x80221000 XSPI1 blocks up to offset 0x19C — xSPI
0x80240000 MBXSEM blocks up to offset 0x98 — Mailbox and Semaphore
0x80241000 SHOSTIF blocks up to offset 0x4C — Serial Host Interface
0x80280000 SYSC_NS blocks up to offset 0x1104 — System Control for Non-safety region
0x80281200 ELO size 0x8 — Evnet Link Option Setting
0x80281400 ENCSS size 0x2C — Encoder Interface Subsystem
0x80281A10 RWP_NS size 0x4 — Register Write Protection for Non-safety Area
0x81000000 GPT14 blocks up to offset 0xE0 — General PWM Timer 14
0x81000100 GPT15 blocks up to offset 0xE0 — General PWM Timer 15
0x81000200 GPT16 blocks up to offset 0xE0 — General PWM Timer 16
0x81000300 GPT17 blocks up to offset 0xE0 — General PWM Timer 17
0x81001000 SCI5 blocks up to offset 0x74 — Serial Communication Interface 5
0x81002000 SPI3 blocks up to offset 0x6D — Serial Peripheral Interface 3
0x81003000 CRC1 blocks up to offset 0xC — CRC Unit 1
0x81008000 IIC2 size 0x14 — I2C Bus Interface 2
0x81009000 RTC blocks up to offset 0x70 — Real Time Clock
0x8100A000 POEG2 blocks up to offset 0xC04 — GPT Port Output Enable 2
0x81028000 OTP size 0x1C — One-Time Programmable Memory
0x81030000 PORT_SR blocks up to offset 0xE12 — I/O Ports (Safety region)
0x81030C00 PTADR size 0x19 — Port Address Selection
0x81040000 SYSRAM0 size 0x10C — System SRAM 0
0x81041000 SYSRAM1 size 0x10C — System SRAM 1
0x81048000 ICU blocks up to offset 0x1C8 — Interrupt Controller
0x81280000 SYSC_S blocks up to offset 0x324 — Register Write Protection for Safety Area
0x81280800 CLMA0 blocks up to offset 0x15 — Clock Monitor Circuit 0
0x81280820 CLMA1 blocks up to offset 0x15 — Clock Monitor Circuit 1
0x81280840 CLMA2 blocks up to offset 0x15 — Clock Monitor Circuit 2
0x81280860 CLMA3 blocks up to offset 0x15 — Clock Monitor Circuit 3
0x81281100 MPU0 size 0x88 — Master MPU 0
0x81281200 MPU1 size 0x88 — Master MPU 1
0x81281300 MPU2 size 0x88 — Master MPU 2
0x81281400 MPU3 size 0x84 — Master MPU 3
0x81281500 MPU4 size 0x84 — Master MPU 4
0x81281700 MPU6 size 0x88 — Master MPU 6
0x81281800 SYSRAM_CTL size 0x20 — System SRAM Control
0x81281900 TCMAW blocks up to offset 0x14 — TCM access wait state
0x81281920 SHOSTIF_CFG size 0x4 — Serial Host Interface Configuration
0x81281A00 RWP_S size 0x4 — Register Write Protection for Safety Area
0x81281C00 MPU7 size 0x84 — Master MPU 7
0x90001000 MTU blocks up to offset 0xA85 — Multi-Function Timer Pulse Unit
0x90001100 MTU3 blocks up to offset 0x174 — Multi-Function Timer Pulse Unit Channel 3
0x90001200 MTU4 blocks up to offset 0x78 — Multi-Function Timer Pulse Unit Channel 4
0x90001290 MTU_NF blocks up to offset 0x806 — Multi-Function Timer Pulse Unit Noise Filter
0x90001300 MTU0 blocks up to offset 0x29 — Multi-Function Timer Pulse Unit Channel 0
0x90001380 MTU1 blocks up to offset 0x2C — Multi-Function Timer Pulse Unit Channel 1
0x90001400 MTU2 blocks up to offset 0xD — Multi-Function Timer Pulse Unit Channel 2
0x90001600 MTU8 blocks up to offset 0x1C — Multi-Function Timer Pulse Unit Channel 8
0x90001900 MTU6 blocks up to offset 0x174 — Multi-Function Timer Pulse Unit Channel 6
0x90001A00 MTU7 blocks up to offset 0x78 — Multi-Function Timer Pulse Unit Channel 7
0x90001C00 MTU5 blocks up to offset 0xB7 — Multi-Function Timer Pulse Unit Channel 5
0x90002000 GPT0 blocks up to offset 0xE0 — General PWM Timer 0
0x90002100 GPT1 blocks up to offset 0xE0 — General PWM Timer 1
0x90002200 GPT2 blocks up to offset 0xE0 — General PWM Timer 2
0x90002300 GPT3 blocks up to offset 0xE0 — General PWM Timer 3
0x90002400 GPT4 blocks up to offset 0xE0 — General PWM Timer 4
0x90002500 GPT5 blocks up to offset 0xE0 — General PWM Timer 5
0x90002600 GPT6 blocks up to offset 0xE0 — General PWM Timer 6
0x90003000 TFU blocks up to offset 0x38 — Trigonometric Function Unit
0x90004000 ADC120 blocks up to offset 0xE4 — 12-Bit A/D converter
0x90004800 ADC121 blocks up to offset 0xE4 — 12-Bit A/D converter
0x90005000 POE3 blocks up to offset 0x2D — Port Output Enable 3
0x90006000 POEG0 blocks up to offset 0xC04 — GPT Port Output Enable 0
0x90008000 DSMIF0 blocks up to offset 0x7F0 — Delta-sigma Interface 0
0x90008800 DSMIF1 blocks up to offset 0x7F0 — Delta-sigma Interface 1
0x90040000 HDSLD0 blocks up to offset 0x68 — HIPERFACE DSL for Drive Interface Unit 0
0x90041000 HDSLS10 blocks up to offset 0x80 — HIPERFACE DSL for Safe Channel 1 Unit 0
0x90042000 BISS0 blocks up to offset 0xFC — BiSS-C Unit 0
0x90043000 ENDAT0 blocks up to offset 0x40 — EnDat2.2 Unit 0
0x90045000 AFMT0 blocks up to offset 0x204 — A-format Unit 0
0x90050000 HDSLD1 blocks up to offset 0x68 — HIPERFACE DSL for Drive Interface Unit 1
0x90051000 HDSLS11 blocks up to offset 0x80 — HIPERFACE DSL for Safe Channel 1 Unit 1
0x90052000 BISS1 blocks up to offset 0xFC — BiSS-C Unit 1
0x90053000 ENDAT1 blocks up to offset 0x40 — EnDat2.2 Unit 1
0x90055000 AFMT1 blocks up to offset 0x204 — A-format Unit 1
0x90060000 ENCOUT blocks up to offset 0x18 — Encoder Divided-Output Module
0xC0060000 GSC blocks up to offset 0x24 — Global System Counter

## Licence text in the file
Copyright (c) 2020 - 2025 Renesas Electronics Corporation and/or its affiliates * * SPDX-License-Identifier: BSD-3-Clause
